## kbuild/resource/tests/test1/kbuild/Kconfig
```kconfig
#
# For a description of the syntax of this configuration file,
# see Documentation/kbuild/kconfig-language.txt.
#
mainmenu "multi-build test"

source "main/Kconfig"
```

## tests/experiments/test/kbuild/kconfig.kmax
```kconfig
config CONFIG_F bool
prompt CONFIG_F ( not CONFIG_E)
config CONFIG_E bool
prompt CONFIG_E (CONFIG_B)
config CONFIG_B bool
prompt CONFIG_B (CONFIG_A)
config CONFIG_A bool
prompt CONFIG_A (1)
config CONFIG_D bool
config CONFIG_G bool
prompt CONFIG_G (1)
config CONFIG_C bool
prompt CONFIG_C (1)
def_bool CONFIG_C 0 (1)
dep CONFIG_F ( not CONFIG_E)
dep CONFIG_E (CONFIG_B)
dep CONFIG_B (CONFIG_A)
rev_dep CONFIG_D (CONFIG_C)
rev_dep CONFIG_G (CONFIG_E and CONFIG_B)
```

## tests/experiments/test/kbuild/main/Kconfig
```kconfig
menu "example configs"

config A
	bool "A"

config B
	bool "B"
  depends on A

config C
	bool "C"
  select D
  default n

config D
	bool

config E
	bool "E"
  depends on B
  select G

config F
	bool "F"
  depends on !E

config G
	bool "G"

endmenu
```
