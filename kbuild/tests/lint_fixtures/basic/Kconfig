## kbuild/tests/lint_fixtures/basic/Kconfig
```kconfig
config MODULES
	bool "modules"

config FOO
	bool "foo"

config DEAD
	bool "dead"
	depends on FOO && !FOO
```

## smartconfig/tests/fixtures/smartconfig_kernel/Kconfig
```kconfig
mainmenu "SmartConfig fixture"
config PARENT
	bool "Parent"
config CHILD
	bool "Child"
	depends on PARENT
config MODE_A
	bool "Mode A"
config MODE_B
	bool "Mode B"
choice
	prompt "Mode"
	default MODE_A
	config MODE_A
		bool "Mode A"
	config MODE_B
		bool "Mode B"
endchoice
```

## tests/test1/kbuild/main/Kconfig
```kconfig
menu "example configs"

config A
	bool "A"

config B
	bool "B"
  depends on A

endmenu
```
